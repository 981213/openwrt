## target/linux/siflower/files-6.6/drivers/phy/siflower/Kconfig
```kconfig
config PHY_SF19A2890_USB
	tristate "SIFLOWER sf19a2890 USB2.0 PHY driver"
	default n
	select GENERIC_PHY
	help
	  Enable this to support the USB2.0 PHY on the SIFLOWER SF19A2890.

config PHY_SF21A6826_USB
	tristate "Siflower SF21A6826 USB2.0 PHY driver"
	default n
	depends on HAS_IOMEM
	select GENERIC_PHY
	help
	  Enable this to support the USB2.0 PHY on the Siflower SF21A6826 SoC.
```
